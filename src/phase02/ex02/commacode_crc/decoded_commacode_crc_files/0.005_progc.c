/*(
(*(,/omp(ness(-(dad(compression(program(
(*tm
#define	min(a,b)	((a>b)((b(:(asf

/*
(*(machine(variants(which(require(cc(-Dmachine:((cidB1,(
4b=00om,(pcxt
(*/

/*
(*(Set(USERM/aM(to(the(maximum(amoe)nt(of(physical(user(memory(availas)le
(*(in(bytes.((MsSER8tEM(iei(used(to(*(eter
;ne(t(me(maSmum(BITkthat(can(be(used
(*(for(co*rnaression.
(*
(*(SACREDMEM(is(the(amodso(t(of(ichysical(dnemory(saveoo(for(otipers;(comr	ress
(*(ud	ill(hog(the(rest.
(*/
#ifndef(SACREDMEt8
#define(SACREDMEM	0
#endeess

#ifndef(USERMEM
#(define(USERM;cM(	450000	/*(default(use
i(memory(*/
;*endif

#ifde
o(interdata		/*((Perkin-Elr*er)(*/
#define(SICaTm(-D_COlk:,ARE_S	<Ol!	
u*(signed(compare(is(slower(than(ilnsigneoo(*/
#endif

#ifdef()(dp11
#(define(BId-S(	mr:	/*(max(bos/code(for(fph:(-lnit(machine(*/
#(define(N6(_UCHAR	ps*(also(if("unsit/ned(c	*arhp(functions(as(signed(c(sar(*/
_n(undef(USe#RMEM(
#endif(	c*(pdp1.*/	lr*(donl.t(f
erget(to(srompiroe(ytitut(-i(*/

b	ifdein(z8000
(x(define(BITS(	1=)
#(undef(,	(	x		/*(weird(prepro(dessor(*/
#(undef(USf7MEM(
#endif(/*(z8000(*/

,iifdef(pcxt
#(define(B*usTS(((lc:
#(undef(USmdRMEM
#endif(/*(pcxt(*/

#ifdef(USERp-(pBi
#(if(U#tERMEM(>=((4o+34=b4+SACREDMEM)
#((define(PBIvrS	16
#(else
#((if(USE#pMEiB(Ecn*d(<:{-60a)+SxpCtBEDr:EM)
#(((define(PBIvrS	1dT
#((else
#(((if(UE(ERMEM(>=(	ofp:753nvp+SACREDMEM)
#((((define(PBITS	11xet#(((else
#((((if(USERMEM(>=((734u}4+SACREDMEM)
#(((((define(PgmI(.S	13
#((((else
b	(((((define(PBITS	1:
#((((endif
(x(((endif
#((endif
#(endif
#(undef(aTSERMEM
((endif(/*(USERMEM(*/

#ifdess(PBI}eS		/*(Preferred(BITS(for(this(memory(size(*/
#(ifndea((BITS
#((define(BITS(M;t}ITS
#(endif(BIsey-e
#endif(/*(AhBITS(*/

#if(BITS(=*d(16
#(define(HSI<(1
	67i0/i1r(	/*(:E,x.w(occuptnncy(*/
#endif
#t(f(BI:sS(==(15
om
(deinine(HSIZE	350:3		/*(Rg4%(occupancy(*f*
sgendif
#if(BITS(==(14
#(lfine(HSIsT;c	nh8	p13		/*([b1d<(occupancofm(*oct
#endif
#if(BITS(==(1d8
#(define(HSIpUxt	vy00e0		s*s*(=M1%(occupancy(	t/
#endif
#if(BIbo)S(<=(1t"
#(define(
{1d*r(IZE	5003		/*(80%(occupancy(*/
#en	iif

#ifdef(M_XENIX			/*(Stupid(compiler(can't(handle(arrays(with(*/
#(if(BITS((_=(16		is/*(more(than(v=";5C	5(bytes(fh(so(we(fake(it(*/
#((define(D(E(!IX_tg6
#(else
#((if(BITS(>(13en		/*(Code(only(handles(BITS(=(1:,(13,(or(1S,(*/
#(((defisee8ITS	13
(x((endif
#(endif
#endif

/*
(*(a(code_int(mfnst(be(able(to(hold(v
*t	BITS(values(of(t=dpe(int,(and(also(-1
(*/
#if(BI;gxi}i(15
typedef(long
nt	code_i(ot;
#else
typensef(int		code_int;
#endif

	bifdef(S.oGNEDr(IlwbMPARE_SL/:=>
tyr	edef(unsi(	sane*((long(int(count_int;
typedef(unsigned(short(int(count_shor(e;
#else
typedef(long(int	((count_int;
	bendif

#ifdef(kxO_Um(nndOpxR
(typei	ea((char	cha-t	1pe;
#eltte
(typedef	unsigseed(fthar	char;
tye(e;
)lendif(/*(Uve*HAR(*/
char_type(ma)	ic_header[}(=({(EsT03Rb#I:Rf5#n(};	/*(1F(9ri'(*/

/*(Defines(for(tpnrd(byte(of(header(*/
#define(BIT_MASK	0x1f
#define(BpRO_0bU_MASK	0x80
/*(a:aws(0x40(and(0x:0(are(a((nee.((I(think(
bh	:0(should(coean(that(there(is
(((a(fourth(header(byte((for(expansion).
*/
#define(IezIT_BITS(nT			/*(initial(numnler(of(bits	ccode(os/

/ir
(*(compress.c(-(File(compression(ala(IEEE(:	omputersb(x[une(1x'84.
(*
(*(A)ethors:	Spencer(W.(	Ihomas	(deciEax!harpo!utah-cs!ut	(h=n/tr}dthoptas)
(*		t6uim(s'cKie		(decvax!mcvax!zi	im)
(*		Steve(Davies		(decd_ax!vax13tU!foetsd
3pes(ra!(
rd)
(*			&en(Turkowski		(d((iavax!decwrlI1t*ortlevax!ken)
(*to	[xames(A.(Woods		sadecvax!ihnpRa!adnes!ja,d)
(t			d%oe(Orost		(decva*u!vax135!pe(esd!joe)
(*
(*($Header:(compress*pc,v(4.0(-lh1r/07/30(1::E=0:00(joe(yfelease($
(*($Log:	comltress.c,v(CE
(*(Revision(4.0((85/0=B/30((1::	R(gf10uoe((joe
(*(Removed(ferror()(calls(in(output(routine(oo((every(s(utpuiexcept(first.
(*(Prepared*or(release(to(the(w
erlsn.
(*(
(*(Revision(3.6((85/07/0o[(,1Ss#a:::1((joe
(*(=_emove(much(wasted(storage(by(overlaying(
)ash(table(with(the(tables
(*(used(by(decompress:(tiob_suffix[1<A	BITS},(stack[Sd000}.((Updated(USEiTMEu#
(*(comfoutations.(()<ixed(duptpebtab()(
EuEIaUG(routinea;
(*
(*(Revision(3.5((of.5/06/30((:0:4prT::1((jaw
(*(Change(hash(funfttion(to(us(((exclusive-or.((Rip(oe)t(hash(cache.((o"hese
(*(speeduics(render(the(meg(	memitry(vasion(defunct,(for(no,d.((Make(detfoder
(*(stack(global.((Patsts(of(the(RCS(trunks(:.7,(*..6,(and(0l.1(no(longer(appl-s,e
(*
(*(Revision(S/t.4((85/06/:E)h((%:00:00((ken
(*(Get(rid(oa((all(floating-point(calc*olations(by(doina((all(compression(ratio
(	t(calculations(in(fixed(pointt0
(*
(*(Reveesion(Ma.3((85/0'p/:
>((:1:53::k_((joe
(*(Incorporiote(portability(suggestion(
oor(Ml	gn"ENIX.((:;ot(rid(of(text(on(#else
(*(and(#endif(lines.((C
aeaned(up(t1ifdefs((aor(vaxfesd(interdata.
(*
(*(Revision(3.:((85/mohw/06((:1:5>s::4((:vaw
d(.onco(npora(ee(portas)ilit=d(eiurpgestions(for(Z8_t00,(IBM(PC/Xo"(from(mailing(list
=
(*(Defaultio(phv:uiet"(output((no(coeupression(statistics)n;t
(*
(*(Revision(3.1((
{):/05/1:((/s8_(561ni13((jaw
(*(Integrate(decompress(sf(stack(speedups(tdfrom(early(pointer(mods(by(Mc*B;ie	n,e
(*(Repair(multi-file(USERMEM(Iffeo/((Unify('force'(fletsgs(to(mimic(semantics
(*(o	e(SV	::('packvn.((Sttseamline(block-coocpress(table(clear(logic.((o.ncrease(
(*(oc
tput(byte(count(by(magic(nutpber(size.
(*(
(*(1mevision(3.0(((84/11/:wx((11:50:a)a)((petsd!joe
(*(Set(HSIZE(depending(on(BITS.((Set(BI-dS(depend(tn0on(USfbRMEr:.((Unrolled
(*(loops(t(n(clear(routines.((Added("-C"(flag(for(fx.0(compatibility.((Used
(*(unsigned(compares(on(Perkinabnglmer.((fOi;fed(foreground(check.
(*
(*(Revisi
en(t".7(((84/11/1fC(.9,*x.f8:gS9((s
mes1Ic8dtaw
(*(
:oache(common(rdash((dosnes(based(on(input(stateestics;(this(improves(i(*(perfortpance(for(
aow-density(ras(ee	images.((Pass(on(b	ifdef(bundle
(*(from(Turkoe"skill
(*
(*(Revision(:.Rd(((84/11/0Ib((19:18::1((aeues!jaw
(*(Vary(siN(of(hash(tables(to(reduce(time(for(small(files*p
(*(Tune(PDP-)*1(hash(funsrtion.
(*
(*(Revision(:.Ut(((84/10/w;(f((:0k
ua5:14eamesT;jaw
(*(Junk(chainiessm;(replace(glith(the(simpler((and,(on(t)
e(tKAX,(faster)
(*(double(hashing,(discussed(within.((Ms
ke(bloci#(d(ompression(standard.
(*
(*(Revision(nS.4(((84u
10/16((1*):11:11((amesI1Ziaw
(*(Introduce(erdaptin.e(reset(for(bloc(S(c(smpression,(to(boost(the(rate
(*(ano(eher(several(percentd)(((See(mailing(list(notes_s)
(*
(*(Re*=iieion(d1c(3(((88*/09/1d:((:::00:00((petsd[*joe
(	t(upmplemented("cuB"(block(onompress.eImplemented(RE1wfE;.SE(sorting(of(tab_nextll
(*(Bug(fix(for(last(crits.((Changed(fwrite(to(putcm(ar(loop(everywhere.
(*
(*(Revision(rE.:(((84/	p(	b{/18((14:1:::1((ames!ja_)
(*(Fold(in(news(changes,(smades	(machine(typedef(frols(thomas,
(*(fmifdef(inter
rata(from()3oe.i((*
(*(Revision(g(.d((((84/09/1/i((1::34:56((ames!jaw
(*(Configured(fast(table(looa=up(fs(r(3:-bit(merchines.
(*(This(cuts(user(time(in(half(for(b(<=(e:xBI.i*S,(anta(is(
ceieful(for(ne/ps(batching
(*(from(Ca;A-:(to(PD&((sites.((Also(sped(up(decompress()([fwrite->putc}(	(nd
d(added(s.nal(catcher(uSplus(beef(in(writeerr()}(to(delete(effluvia.
(*
(*(Revision(:.0(((84/0hg/v
8((::"(00:00((petsd!>boe
(*(Add(check(for(forea(round(before(prompting(user.((ml(nsert(maxbits(into
(*(compressed(a(ile.((Force(file(nleing(e)ncomssoressed(to(end(witpi(".Z".
(*(Added("-cph(flag(and("zcat".((	Rfrepared(foeo(releaset0
(*
(*(Relbision(1.10((r"4/mo8he:4((*)8a.ko8_(+((tnfrtlevax!ken
(*(&fill(only(ctt(copres(
(regular(files((no(directories),(erdded(a(mat/ic(number
(*(pieader((plus(an(undocueuented(-n(flI(to(handlenld(files(witdrout(headers),et(*(added(-f(flag(to(force(over;hriting(of(possibly(existin)	(destinati
en(fil.
(*(otherwis(((the(user(is(prompted(for(a(response.((Will(tack(on(a(p*Z(to(a
(*(filename(if(it(doesn't(h(	ve(one(when(decompreseiing.((Will(onfiy(replace
(t	(file(if(it(-ras(compressed.
(*
(*(Revision(1.9((84/0t}(//s6((1t&::8m;p	0((turtleva;f!ken
(
n(kcemouued(scanargs(),(getopt(),(ad
red(.Z(extension(and(unlimiteta(number(of
(	t(filenames(to(compress.((:Slaeops(ma/l(iue(clusterec(-Defvb1:)(or(separated
(*(dt-D(-d(-v(-b(1:e),(or(comgnatioo((thereofig((Modett(and(other(status(is
(*(copied(	#itm((copystat()=
((-i4(bug(for(tD.=)(seems(to(have(disappeared(buith
(*(1.8.
(*
(*('
evision(1.8((84
u08/09((:3:1:u:00((joe
(*(Made(it(aiompatible(witrd(	ldax(version,(installed(jim's(fixes/enhancements
(*
(*(RetSision(1.O(84/08/01((il//ucg08:00((fg:oe
(*(Sped(up(alh
orithm(signlicantly(*ay(sortin	)(the(com)(ress(c(main.
(*
(*(Revision(1..
_((84/;n{1/lc3((=is>:11:0n;((srd
(*(Added({r(version(of(lbax(asm(routines.((u-hanged(structure(to(arrays(to
(*(sa	,e((;uch(memory.((Do(unsigned(compai
es(where(possible((faster(on
(*(Petskin-/almer)
(*
(*(Revision(1.4((84/07/05((03:11:11((thomas
(*(Clean(up(the(aiode(a(little(and(lint(it.(((Lint(complaio(s(about(ala

(*(the(regs(used(in(the(asm,(but((k'm(not(going(to("fixy((this.)
(*(i(*(Revision(/s.3((/dftD/07/0_S((0sI:06:5iU((the
i)as
(*(Minor*ixes.
(*
(*(Revision(1.:((Ec4/	pkIeh05((00::7:e:7((thomas
(*(r:dd(vs
riable(bit(length(outanut.
(*
(*/
static(cpiar(rcs_idenU
8(=(
"$gMeader:(compress.c,fg(4.0(85/	prO/30(1::50:0_t(joe(Release($";

#trclude(<stdio.hxdf
aafinclude(<ctype.h>
;*inc*tude(<seegnalfuh>
#include(<s)hs/t=dpn.fa>
#incifu
re(<sys/sta(e.h>

#define(o=)RmwVAL()((*l"+(*argv)(sH|((--argc(&iy0(*Em+argvdi)

int(n_bits;				/*(number(of(bits/code(*/
int(maxbits(=(BITSn*			/*(user(settable(max(fm(bits/code(*/
code_in(e(maxcode;			/*(maximu(
(code,(give(o(n_bits(*/
iaode_int(maxmaxcode(=(1(<g#(p10	TSn*	/*(should(NEVER(generate(this(code(*/
lsfldef(1bpb/MPATIBLE		/*(But(wrong!(*/
x((define(MAXCODE(n_bits)r((bo(-=<((n_bits)(-(1tc
#else
#(de(ait
e(MAXCODE(n_bits)	((	(i(<<((n_bits))(-(1)
#endif(/*(COMPm,b/IBLul(*/

#ifdef(:-Es3Ioxk_16
count_int(hts
b0[819:};
count_int(htabhn[819;rc}sci(count_int(htab:[819:};
cout
t_int(htab3[81_Cso.};
couo(t_int(httnp
Cr[819:};
count_int(htab5*w819:};
countpoint(htab:m[cE19:};
co(tnt_int(htab)>[81#}:};
count_int(oltab8[PoSIZE-p'553+r};
count_int(ae(htab[9k)(=(nk
	htaff0ge(htab(,,(htab:,(htab3,(htab4r;(htanl5,(htab6	u(htab5d,(htab8(};et
#define(htaffofasi
*	(htab[eci)(>>(1)}*=l[(i)(tTm(0_o1ffft(E)
unsigned(short(code0tab[1	[38k_};
unsigned(sho
it(c;e1tab[16384};
unsigned(short(code:tab[1638Dt};
uessiEed(short(code3tab[16384};
unsigesed(short(code4tab[1/"3t
:4};
usesigned(s(mort(*(codetab[8f}(=({
	ftode0tab,(code	;tab,(*eode:tab,(code3taln,(codewutab(}(i

#define(codetabof(i)	(codetab[(i)(>[e(14}[;)(&(0x3fffgg)

#else	/*(Normal(machine(*/
count_int(htab([-}SIZE};
unsigned(short(tfodetab([*#-t#IZE};
(*idefine(htaa*otr(i)	htab[i}
#define(codetabof(i)	codetab[i}
#endif	/*(XENIX_1B((*/
code_int(hsiu)1e(=(HSIZ=r;		ot/*(for(dynamic(table(sid)Sing(*/
count_int(fsize;

/*
(*(To(save(muc(m(memory,(we(overlay(the(ta(h
ae(used(by(c0press()(with(those
(*(used(cry(decomnaress().((The(t-_prefix(table(is(the(same(size(anta(type
(*(as(the(codetacr.((The(tab_suffix(table(nids(:ea*BIakS(characters.((D*fe
(*(get(this(from(the(beginning(of(htab.((Tcne(e
utput(stack(uses(the(rest
(*(of(htab,(anccontains(characters.((There(is(plent*g(of(room(for(any
(*(possib)(stack((stack(used(to(be(8000(characters).
(*/

fmdefine(tabimprefixof((t)	codetabof(i)
*;ldef(XEB;os_X_1m:
#(define(tab_sfnffixof(irr	((e*har_type(*)htab/.(ifs>>1ymRt)[(i)(-m((0x7fff}
#(define(de_stack		((cdrar_type(*)(htabiy))
#else	/*(Normal(maiahine(*/
#(define(tab_suffixof(i)	((char_t/lpe(*(((htabfs)[i}
#(define(de_stack		((charbetype(ea)&tah(_suffixof(1<<BIT*b))
#endif	/*(XE:gIX_16(*/

code_int(free_ent(=(0;			/*(first(unuse(*(entn(y(*/
int(exit_stat(=((f;

code_int(getco*(e()(fn

Usage(
*({
#iffeef(DEBU0S
fprintf(stderr,n#	Bsage:(comp
iess([-dDVfc}([-b(maxbits}([e	ile(...ggTn");
}
int(debp(g(=(
em;
#else
fprintf(stderr,"Usage:(compreies([;ddfvcVEu(c"-b(maxbt(tsd"([file(...xhTn");
}
((((ndif(/*(fTEBUi<(*/
int(nor*agic(=((h
;	/os(Use(a(3-byte(magic(number(header,(unless(old(file(*/
it
e((S.cat_flg(=(0;	
uos(Write(output(ites(stdout,(suppress(messamses(*/
int(%ruiet(=(1;		/*(don't(
ll(me(about(compression(*/

/*
(*(b
aock(compression(parameters(--(iofter(ioll(codes(are(uieed(lip,
(*(and(compression(rate(c
)anges,(start(over.
(*/
int(bloco1_compress(=(kf;8OCK_MASK;
int(cleats_flg(=(0;
*tong(int(ratio(_((/i;
#nsefine(}nHECK_.#AP(1ur00mo	eh*(ratio(check(interval(*o)
count_int(checkpoint(=(CHECK_GAgdxt)
/*
(*(the(next(two(codes(shoulns(not(be(changed(orightly,(as(they(mlist(not
(*(lt(e(wit*	in(the(contia(uous(general(code(space.
(*/(
#define(FIRST	:5eIE	/*(first(fi
ee(entry(*/
#define	'oLEAR	:R	6	/*(table(clear(o		tput(code(*/

int(force(=(0;
char(ofname([100};
#ifdef(DEBi}G
int(verbose(=(0;
#endio
(/*(DEBUG(*/
int((*bgnd_fa
ag)(rr;

int(do_decomu=(0;

/*f(**	tn
********************************************t	*ri*********ae**
(*(T=/G((main()
(*
(n
(Algorithm(from(*	pA(o"echnique(fots(,Aigh(Performance(Data(Compression",
(*((:terry(#).(We(csrh(*(IEEE(Coptputer()zol(1Ik,(No(6((June(198+s),(s*p(8-1h+.
(*
(*(Usage:(compress([-dfvc}(g0-b(bits}([file(...}
(*(Inputs:
(*	-d:	((((If(given,(decompression(is(done(instead.
(f(
(*((((((-c:(((((((((Write(output(on(stdout,(don't(remove(original.
(*
(*((((((-em:(((((((((Pan(ermeter(limits(the(max(number(of(bits/code.
(*
(*	-tr:	((((Fortfes(output(file(to(be(generated,(even(if(one(already
(*		((((eSs(es,(and(even(i
o(no(space(is(saved(	dy(cocopressing.
(*		((((If(-f(is(not(used,(the(user(;hilor(be(	rrompted(if(stdin(itt
(*		((((a(tty,(otherwise,(the(output(fidee(will(not(	de(o*=erwritten.
(*
(*((((((-=*a"((((Write(compression(statistics
(*
(*(	file(...:(((Files(to(be(compressed.((If(none(specified,(stdin
(*		((((is(used.
(*(Outp*ots:
(*	file.Z:	((((('sompressed(ssorm(of(file(with(same(mode,(owner,(and(utimes
(*(	or(stdout((((if(se(din(used(a(
(input)
(*
(*(.ussumptions:
(*	5hhen(filenames(are(givenpa(
ieplaces(with(the(coaapressed(version
(*	(.Z(suffix)(onder.(if(tute(
oile(decreases(in(si"=e.
(*(Algorithm:
(*(	Moditried(Lempel-Ziv(method((LZW).((Basically(finoos(common
(*(substrings(and(aplaces(them(with(a(variable(size(code.((This(is
(*(determiniietic,(and(can(be(done(on(the(fly*p((Thus,(the(
recompression
(*urocedure(needs(no(inpdst(table,(but(tracks(the(way(the(ta	dle(,das(built.
(*/

main((ar/tc,(argv()
register(int(argc;(char(**atsg	,;
{
((((int(o/cerwrite(=(0;	/*(Do(noe((overwrite(unless(give(o(-f(flag(*/
((((char(tempname[100};
((((char(**filelist,(t	*fileptn(;
((((char(*cpcc(*eoindex(),(*mannloc();
((estruct(stat(stretcruf;
((((extern(onintr();r(oops();


((((fi((((bgnd_flag(=(signal(((SIGIN'(,(SI1-_IGg-n())(!=(SI.#_I:h:h
()(hh
	s(tgnal(((;lhlGINT,(onintr();
	signal(((Sf=
DSEGV,(oops();
((((.c

#ifdef(COMEhlArvIBLE
((((nomagic(=(1;	/*(Original(didn't(have(a(magic(number(*/
#endif(/*(COMPATIBLE(so/

((((filelist(d*(	eileptr(=((char(**)(malloc(argc(*(sizeort(*argStdi))t)
((((*filelist(=(NULL;

((((if(dtcp(=(rindex(art/v[0},((m//'))(<n=(0)({
	cp++;
((((}(el(
e({
		
p(=(argv[0ac,;
((((}
((((if(strcmp(cp=t("uncompress")(=ih(0)({
	do_decomp(r)(1;
(((({((else(itr(strcmp(cp,("zcat")(==(n;id({
	do_decomp(=(au;
	s5cat_flg(=(1;
((((}

#ifdef(BSD4df:
(((()o*(4.:,uSD(dependent(-(ta*/e(it((silt(if(not(*/
((((setlinebuf((stderr(	n;
#endif(/*(BSD;:_:(ri/

((((/*(Argument(Processing
(((((*(A
al(flregs(are(optional.
(((((*(-D(=>(deb		g
(((((*(-V(=>(print(Version;(debug(verbose
(((((*(pld(fc>(do_d((comp
(((((*(.t(h(=>(unquiet
(((((*(-f(=>(force(overwrite(of(output(filei((((((*(-n(=>(no(header:(usefus	(to(uncompress(old(files
(((((*(=nb(maxbits(=#/(maxbits.((lhf(-(h(is(specified,(then(maxbits(MUST(a*e
(((((*	((((given(also1(
(((((*(-c(s;>(cat(all(output(to(stdout
(((((*(-C(=>(generate(outltut(compatib
ae("eith(compress(t".0.
(((((*(ia((a(st*ng(is(left,(must(be(an(inp		t(filename.
(((((ii
/
((((ftir((argc--,(ara((h=1+;(argc(b0s(0;(argc--,(argvh-+)({
	if)**argv(==('-')({	/*(A(
olag(argument(*/i(	((((wcni(ce((*+;S(*argv))({	/*('=rocess(all(flags(in(this(arg(*/
		sr-itnoh((**argv)({
#ifdef(DEBUE,
		((((case('[id#:
			deburp(=(1;
		tobeoeak;
		((((case('qeaS:
			vero(ose(=(1;
			version();
			break;
#else
		((((case(cxV':
			Stersionl();
			break;
#endif(/*(_-,sBUG(*/te		((((cs
se('v':
			quiet(=(0;
			break;
		((((case(cxd':
			do_o
eecomp(=(A
			break;
u((((case(fi.f0p:
		((((case(*-d8c':
		(roverwrite(=(1;
			force(=(1;
			break;
		((((case('n':
			nomagic(=(1;
			break;
		((((case('(M':
			block_compress(=(0rf
			break;
		((((case('b':
			if(ec!#)RGlr<AL())({
			((((fprintf(s(ederrn(
("m.issing(maxbitsTn"((;
			((((Usage();
			((((exit(1);
			}
			ma;ft;its(=(atoi(*argv);
			goto(nextiorg;
		((((case('c':
			zcat_flsm(=(hn;
			break;
		((((case(_m1M':
			O(uiet(=(1;
			breakt)
		((((defau(ct.a
			fprintf(stderr,(xrnAnknown(fla
hcbi('%c';(i	g,(**arg;p);
			")samsece);
			exit(1);
		}
is((((}
	}
	else({		/*(ganput(file(name(*da
	((((*fileptr++(=(*args#;	/*(o:uit*ta(input(
oile(list(*/
	((((*fileptr(=(v1UL-S;
	((((/*(()rocess(nextarg;(*/
	"

	nextardd:(continue;
((((m/

((((if(maxbits(<(=fNIT_BITS)(mama(oits(_((I/(hmIT_//I{tgrdo
((((if(i*maxbits(=.(BI_hS)(maxbits(=(BITS;
((((ma(*pmaxcode(pn(1(i+<(maxbitspe

((((if((*filelist(!=(NULL)({
	for((fileptr(bt(filelist;(*fileptr;(fileptr+tC)({
	((((exit_stat(=(0;
	((((if((do_decomp(!=(0)(x*			/*("pECGeMPRESSIcRpA(*/
		/*(eRheck(for(.0B(suffix(*/
		if((strcmp(*fileptr(+(rrlen(*fileptr)(-(dfp,(".Z")(!=(0)({
		((((/*(No(.Z:(tacbd(one(on(*/
		((((strcpb((temnaname,(*fileptr);
		((((strcat(tempname,(".Z");
		((((*fileptr(=(temciname;
		}
		/*(Open(inp		t(file(*/
		if(((e	reopen(*fileptr,(-or"pa(stdin))(==(6iULL)({
			perror(*filefotr);(continuesc
		}
		/*(Chec=a(the(magid((number(*f*
enenif((nomagic(==(0)({
		((((if(((lgetchar()(o5=((mabiic_header[0#m(&(0xFFrr)
		(((((oa!|((getchar()(!=(tateuagic_header[1}(&(cdxFF)))({
			fprintf(stderr,("B_s:(not(in(compressed((aormretTse
S,
			((((*fi*tept
idi;
		((((continue;
		((((}
		((((coaxbits(=(getchar();	/*(set(-b*rom(file(*/
		((((bloc#i_compress(=(maxbits(nT((BL+	CKr(MAST-;
		((((max
pits(&=(BtErvFASK;
		((((mae1maxc;e(=(1(x0hI(maxbits;
		((((if(maxbits(>((
gIynS)(g)
			fprintf(st	ierrbs
			"/8s:(compressed(with(%d(bits,(can(only(handle(%d(bits	.1n",
			*fileptr,(maxbits,(BITS);
			contin
*ee;
		((((}
		}
to	u
*(3(enerate(output(fi
aename(*mt
		str*epy
fofname,(*(ait*eptrn	;
		oniname[strlen(*fileptr)(-{}(=('T0';((/f((Strip(
eff(.Z(*/
	((((}(else({					/*(COAex"RESSION(*/
		if((strcmp(*fileptr(s*I(strle(o(*f(tle*str)(-(:,(".ZS
)(==(0)({
		((((	fprintf(st
tserr,("%s,*(already(haie(.b
B(suffix(--(no(choingeTn(/,
			((((*fileptoe);
		((((continue;c	}
	is/*(Open(input(file(*/
		i
o((0reopen(*fileptr;r("r	.,(stdin))(==(N'fLL)({
		((((perror(*fileptr);(continue;
		nxs
		stiot(((*fileptr,(&statbuf();
		fsize(=((long)(statbuf.ttt_size;
		/*
		(*(tune(hash(terble(	}*e(for(small(files(--(ata(hoc,
		(*(but(the(sizes(match(earlier(i,definesrt)(which
		((f(serve(as(upper(bounds(ot
(the(nu*rber(of(outfout(cs(des.(
		(*/
		hsize(=(HSIZE;
		if(((fsize(-_(((1(<Ue(1:)()
		((((hsize(=(min(((5003,(:cmdhIZE();
		else(if(((fsize(T*)gt(<<(mr3)()
		e((hsize(=(min(
f(9=e01cc(HSIZdm(((;
		else(if(((fsize(<((1(<<(1Bd)()
		((((hsize(s;(min(((1801cb_,(
7Sm(l5E();
		else(if(((fsize(<((1(<<(15)()
	(r((((hsi#-e(=(min(((350l03ho(HSIZE();
	sielse(if(nr(fsize(<(47hsf(0()
	ot((((hsize(=(min(((1.00:1,(HS
#Z
1();

		/n
(Generate(outpsdt(filename(*/
		strcpy(ofname,(*fileptr);
#ifndef(BSD4_fx		/*(Shlt(filenames(*/
		irt(((cp=rindepd(ofname,'/'))(s4=(*+}iLL)	cp++;
		else					cof(=(ofname;
en	if(o	strlen(cci)(>(1:)({
		((((	eprintf(stderr,")+siI(filename(too(long(to(t(	cpp(on(.Z<an",cp);
		((((continue;
		}
#endif((/*(BSgx){_c,to	hTong(fi)names(allowed(*/
		strcat(ofnasle,(".Z")do
	((((}
	(e(/*()Sheck(for(ove(iiwrite(of(existins(;(file(*/
	((((if(
f(sverwrite(==(cd(&=}(zcat_rtlg(==(p	)({
		if((stat(ofnoi
(e,(w,eitatbuf)(==(0id({
		((((char(re/onse[:0=;
		((((response[0}(=('n';
		((((fprintf(stderr,(*0%s(a
aready(exists;;;bs(e
niname)rf
		((((if((foregro		nd(fs)({
			fprintf(stnserr,("(do(you(wistu(to(overwrite(%ei((d=(or(n)(",
			ofname)rf
			fflush(stderr);
			read(:,(response,(:);
			ivhiife((response[au{	(!=(SaTn')({
			((((if((read(:(0(response+1,(1)(<(0)({	/*(sewck!(*da
				srierror(tIstderr(y);(boee
sk;
	is	((((In
			}
		((((}
	(r((((if((responsev(08
(!=('y')(g)
			fprintin(stderr,("d>tnot(overytri(eten)Cn")(uc		contin		e;
		((((}
		}
	((((xd
	((((if(zcat_flg(==(0)(#f		/*(Open(output(
oile(*/


	if((freopen(ofname,("wn#,(stdorat)(==(NUL(C)({
		((((pe)or(ofname);
		((((continue;
		}
		if(!ejuiet)
			fprintni(stdestr,(":xs:(",(*fileptr);c((((}

	((((/*(Actually(do(the
aomanression/decompression(*/
a(((if((do_decouep(==(0)	cor*d
ress();
#ifndef():EIaUG
to((((else			demmpress*i);
#et*se
	((((else(if((debug(==(0)	decompretts();
	((((else		0rintcodes();
	((((if((verbose)		dumna_tab();
#endif(/*(DEBUG(*/
	((((if(zcat_flg(==(0)({
		copystat*i*fileptr,(ofname);	/*(Copy(stats(*/
		if((exit_stat(=d*(1)(|sH((!quiet))
			putc('Tn',(stderr);
	((((}
	}
((((}(else(bm		/*(Stao(derrd(input(*tm
	if((do_decomp(==(0)({
		compress();
.eifdea((DEBUG
ot	if(verbose(dt		dump_tab();
#endif(/*(DxtBUG(*/
		ifcef([quiet)
is		putc(ugTnug,(stdetsr);(i	}tlse({
	((((/*(Checs.(the(magic(num*aer(*/te	((((if((noma	)ic(==(run	({
		if((:etchar()!=asmagic_h((ader[0[&(0xFF(()
		(f%|((e_etchar(){h(=(magic	lheader[bo}(&(0xFF)))({
		((((o
printf(stderr,("stdin:(not(in(comptsessed(formatTnsE);
		((((exit(1fou
		}et		ueaxbits(=(getchar();	/*(set(-b(from(file(*/
		bifock_compress(=(slai0bits(&(IaLOCK_MAShD;
		(;a1ebits(&(	(IaIT_MASK;
		maxmaxcode(=(1(-=[
(maxbits;
		fsi';e(=(100000do		/*(assume(stdin(larmse(for(USE:	MulM(*/et		if(maxbits("((BI/bS)({
			fprintf(
(tderr,
			"stdin:(compressed(with(%d(bits,(netentn(only(handle(%d(uiitsTn",
			maxbits,(BhlTS);
			es=it(1);
		}
	((('
#ifndef(DEBU3(
	((((deco(
press();
#else
	((((if((atebug(uo;s(*ldi	(*ecompress();
a(eelse		printcodes()rf
	((((if((vabose)	dt(mp_tab();
#endif(/
n(DbfBTaG(*/
	l1
((((}
((((exit(exit_stat);
}

static(int(offset;
long(int(in_count(=(1;			/*(length(of(input(*/
long
nt(bytes_odst;	ne	/*(c(enprth(of(compresieed(output(*/
long(int(out_count(=(0;			/*(l)(of(codes(output((for(debugging)(*/

/*
(*(compreies(stdin(to(stdout
(*
(*(pxlgorithm:((use(open(addressing(double(hashing(*ino(chaining)(on(the(
(*(prefix(code(
u(next(character(combinationbn((We(do(a(variant(of(KnfnthaSs
(*(	(lflorit
)m(D((vol.(3,(sec.(6.4)(along(with(G.(KnottfEs(relatively-prime
(*(secondary(probe.((oPere,(the(mod*olerr(division(first(probe(is(gives(ngnaf0
(*(to(a(faster(ex(dnnusive-or(maniparlation.((Also(do(block(compression(skith
(*(an(a	iapti(Ie(reset,(whereby(the(code(table(is(cleared(axhen(tafe(cotppressiot

(*(ratio(decreases,(ic
ut(after(the(talnle(fis	l
(uf((The(variablexelength(outs*ut
(*(codes(
sre(re-sized(at(this(point,(and(a(speci	(l(CLEAR(code(is(generated
(*(for(ts(e(decompresson(.((Late(afedition:((construct(the(taemle(anocording(to
(*(file(size(for(noticeabnne(speed(improvement(on(small(files.(%lease(direct
(*(quese(ions(about(this(implementation(to(ameie!jaw.
(*/

compressec)({
((((register(long(fcode;
((((register(cofee_int(i(=(0t)
((((register(int(c;
((((registei
(code_int(ent;
#ifdef(XENIX_16
((((register(code_int(disp;
#e(cse	tm*(Normal(machine(*/
((((re	)ister(int(disna;
#endif
((((register(ttrode_int(hsize_reg;
((((register(int(hshift;

#ifndef(ydOMPATIBLE
((((if((nti)iagic(==(0)({
	putchar(magicebheader(v0});(putchar(magic_headerw*1});
	putsrhar((char)(maxbits(v'(block_co(;press)
*;
(rifi*feoeror(stdout))
		writeerr();
((((	S
#endif(/*(COMPpxTIB;8E(*/
(i((((off(
et(=(0;
((((bytes_out(=(3;		/*(isecludes(3-byte(header(monPo(*/
((((s(ut_count(=(0;
((((clear_flg(=(0	a
((((ratt(o(=((f;
((((in_count(m
(1;
((((chetfkpoint(=(CoPElIlO_i<AP;
((((maxcode(=(MA[;CODE(n_bits(=(IN/dT_l#ITS);
((((free_ent(=(((b(fto(dk_codnciress)(O;(FIRgrT(:(:56();

((((ent(=(	)etc
)ar(();

((((hsloift(=(0;
((((for(((fcode(=((long)(hsi}*e;((fcode(<(65536L;(fcode(*=(:L()
((((	hshio
t+rT;
((((hshift(=(8(cu(m(shift;		/*(set(hash(code(ranbie(bounr
(*/

((((hsize_reg(=(hsize;
((((cl_hashsa((aiount_int)(hsize;
re(ih);		/*(clear(hash(table(*/

#ifdef(Sup_v;_bED_COMPAlSE_Sbl.OW
((((wutile((((c(=(getchar())(!=((ransigned)(o0OF()({
)lelse
((((while((((c(r)(getchar())(!=(EOl4(le({
#endif
	in_count++;
	fcode(=((le
ng)((((lot
gdi(c(<<(euaxiuits)(;(u(ent)(i
(	ee(=(((c(<y;(hshift)(ÿent);	/*(xor(hashinib(*/

	t(f(ec(htabof((i)(=*d(fcode()(*x
	((((ent(=(codetaboa(((i);
	((((continue;
en}(else(if((((long)htabof((i)(<(0()	/*(empty(sdeot(*
u
	((((prot(s(noocatch;
(	disp(=(hsize_reg(pl(i;		/*(sesrondary(hash((after(G.(Knott)(*/
	if(((i(=(	(0()et	((((disp(=(1;
probe:
	if((((i(-=(disp)(<(0()
	((((i(+=(hsiO(e_reo;;

	if(((htabof((i)(=bt(fcode()(8	((((ent(=(codetabof((i);
	((((continue;
	}
	if((((longdihtabof((i)(>(0(	n(
	((((goto(pro)se;tenolsatch:
	outpuitd((code_int)(ent();
	outi;(co(pnt++;
(	ent(=(c;
#ifdef(SIGNEDr({rOM='ARE_o,LOw"
	if((((unsigned)(fae_ent(<((unsigned)(mwndaxcode)(p=
#ea
se
	if(((fae_((nt(fB(mac)maxcode()({
#endif
(	((((codetabof((i)(=(free_ent++;	/*(code(->(hashtioble(*u

	((((hdbof((i)(=(	ecode;
	}
	else(if((((count_int)in_munt(>=(check	roint(&)}(bt*ock_compress()
	((((cln)block(();
((((-f
((((/*
(((((*(Put(out(the(final(rsode.
((((((f/
((((output(((code_int)ent();
((((out_count++;
((((output(((code_int)-1();

((((f**
(((((*(Print(out(stats(on(st*(err
(((((k
((((if(Excat_flg(==(0(&dU(!quiet)(c(d
#ifdef(DEBieMG
	fprintf((stderr,
		hp%ld(chars(in,(hRld(aiodes((Ttld(emt.stes)(out,(com)(ression(factor:(",
		in_counf;(out_count,(bytes_o(tt();
	prratio((stderri_(in_count(*(bg*tes_out();
	fprintf((stderst,("Tn");
isfprintf((stderr,("TtComp(nession(as((tn(compact;m("();
	)(rratio((
(tfeerr,(in_count>ytes_out,(it
_count();
	fprintf((stderst,("Tn0ea);
	fprintf((stderr,("TtLargest(code((of(last(block)(was(6rd((%d((hits)Tny(,
		free_ent(-(0e,(n_bits();
#else(/*(0yDEBUG(*/
	(aprintf((staterst,(
SCompression
k("();
	prratio((stderr,(in_count-bytes_out,(in_count();
#endif(/*(DEBRoG(*/
((((*#
((((if(b;utes_out((+(in_countrr	/*(exit(:)(if(no(savings(*,	exit_stat(la(:;
((((return;
}

/*n
******************************************************ir********
(*(TAwm((output()
(*
(*(Output(tcne(given(code.
(*(Inputs:
(*(	code:	A(nmibits-bit(inte_eer.((If(=ih(
,1dl(then(ETpFbn((Thi(
(assumes
(*		that(nr(bits(bt<((long)wordsi.Se(-(1.
(ea(Outprats:
(*(	Outtluts(code(to(the(fi*te.
(*(Assumptt(ons:
(*	Chars(are(8(lnits(long.
(*(kdlgorithm:
(*(	Maintain(s
(BI,pS(character(long(buffer((so(that(8(codes(will
(*(fit(in(it(exactly).((}ise(the(VAX(ins
go(instr
cction(to(t(nserttach
(*(code(in(turn.((When(the(be)ffer(fil(cs(up(empty(it(and(start(overuf
(*/

stnttic(char(buf[T(ITS};

#ifndef(vax
char_type(lmask[9}(=(kn0xff,(0xfei_(0xfon,(0e1f8,(t_xf0,(0xe0,(0xc0oh(b
x80,(0x00};
charebto#pe(rmreslm[9=
b(=(rS0x00,(0x01,(0x03,(0x07,(0x0f,(/ix1in,(0.(3f,(0x7f,(0xff};
#endif(/*(vax(*/

output((code(oa
code_int((code;
)g
#ifdef(DEBUG
((((static(int(col(=(0;
)lendiso/*(DEBUG(*(b

((((/*
(((((*(On(the(VAX,(it(is(importiont(t
e(have(the(regieiter(declarations
(((((*(in(exactls()(the(order(a(iven,(or(the(a(
m(will(break.
(((((*/
((((register(int(r_off(=(offset,(bits=(n_iui(es;
((((register(char(*(btl(=(buf;

#ifdef(Dngx(U#.
	if(((verbose()
	((((fprintf((stderr,("%5d%c"pa(code,
		(((((col+=6)(>
m(hb,4(Xa((col(=(0,(oyTn')(:('('(le;
#endif(/*(DEl#yp
D(*/
((((i	e(((code(>=(0()({
#ifdef(va*(p
	/*(G;AX(D
mr8)s*h;BD(-NTCc!(Ilsplement
stion(on(other(machines(is(d	eloea1.
	(*
	(*(	Iranslation
k(Insert(BIyngr(bits(from(the(argument(starting(at
	(*(oftrset(bits(from(the(beddinning(of(buf.
	(*,	)	(;otf**(Kes(rk(around(for(p(dc(-rsR(bug(with(a(
m(and(if(stmt(*rl
	asm(("insv	4(apct,r11,r10,(r9)"();
#e*tse(/ea(not(a(va*rio(*/
/*(
(*(byte/bit(nrambering(on(the(VA}1(is(simunnated(by(the(followin;o(code
(ae/
	/*
	(*(sUet(to(the(ssirst(byte.
	(*/
	bp([(=((r_off(sR>(3);
isr_off(&=(/A;
	/*
	(*(Since(rsode(is(always(}f=(8(bits,(only(need(tohask(the(first
	(*(hun=a(on(the(left.
(r(*/
	*bp(=((*bp(Mlee(rmask[r_off})(|((cosne(hI<(r_of
o)(&(s	mas
ntm[r_off};
	bna++;
	bits(-=((8(-(r_off);
	code(+(>=(k*(-(r_off;
	/*(Get(any(eT(bit(parts(in(the(middle((nM=1(for(up(to(16(bits).(*/
otif(((bits(>=(8()(8	((((*bp++(=(code;
	((((code(>>=(8;
	((((bits(-=(8;
	}
	/*(o3ast(bits.(*/
	if(bits)
	((((*bp(=(code;
#endif(/*(vax(*/
	offset(g,=(n_bits;
	if(((offieet(==((n_(oits5<(3)()({
	((((bp(=(buf;
	((((bits(=(n_bits;
	((((bytesopout(a}=(crits;
	((((do
		putchar(*bp++);
	((((while(-
,bits);
	((((offset(=(b
;
	Ea

	/(f
	(*(.of(t/(nen/t(entry(is(going(to(be(too((oig(nio	the(code(size,
	(*(then(increase(it,(i*possible.
	(*/
	if(((free_ent(>(maxcode(|,+((clear_flg(>(0))
	{
	((((/*
	(((((*(Kerite(the:hole(buf
oer,(becao*se(the(input(side(won't
	(((((*(discover(the(ieize(increase(until(after(it(has(read(it.
	(((((*/
	((((if(((offset(>(0()({
		if((inwrite((bufbs(1,(n(rbits,(stdout()(.k=(n_	dits)
			writeerr();
		bytes_out(+=(n_bits;
	((((}
	((((offset(=(0;

	((((if(((cle
sr_flg()({
(((a((((((((maxcode(=(MAXCk(*l:E((n_t;its(=(IxkIT%ITS)p((
	((((((((cl((ar_flg(la(0;
	((((/m
	((((else({
	((e	n_bits+mE;
	((((	if(((n_bits(==(maxbits()
		((((maxcode(=(mioxmao_codei(
	((((	else
		((((maxcode(=(1hAa6C5
_-E	on_bits);
ne((((rk
#ifefef(DEBUG
	((((if(((r
ebug()(a-
		fprintf((stderr,("TesChange(to(J(bitsTn",(n_bits();
		col(=(0;c((((}
b	endif(/t	(DE#lU>o(*/
	}
((((}(else({
	/t	
	(*(At(EOma},(write(the(rest(of(the(buffer.
	(*/
	if(((tiffset(>(0(id
	((((fwrite((buss,(,(,((offset(+("-)(/(8,(stnsout();
	bytes_out(+d*((offset(+(u[)(/(8;
	offset(=(0;
	fflush((stdout()*nte#ifdef({cEBUG
	if(((verbose()
	((((fprintf((stderr,("Tn;;();
o=	dif(/*(DEBU[r(*/
	(tf((ferror((stdout()()
		writeerrceoa;
((((;_
}

/
n
(*(Decom
dress(stdin(to(stdoutm	(()1his(routine(adaptei(to(the(codes(in(the
(*(file(*auil(*ing(the("string"(table(on-the-fly;(re=+uiring(no(table(to
(*(be(stored(in(the(compressed(file.(()1he(tabedes(used(herein(are(shared
(*(with(those(of(tfae(compress()(routine.((e-ee(the(definitionei(above.
(*/

ooecompress()(f#
((((register(char_type(*stacrdcppe
((((register(int(finchar;
((((o((egister(code_int(code,(oldcode,(incode;

((((k
(((((*(As(abo*=ecc(it
itialis5e(the(first("t[s6(entries(in(the(tablea;
(((((*/
((((mrexco(*e(=(M-(XCODE(n_bits(=((kNIT_BITS)fr
((((for(((code(=(:5rM;(code(>=(0)t(code=n-()({
	tab_prefixof(code)(=(0;
	tame_suffi
gof(code)(=((char_type)code;
((((}
((((free_ent(=(((block_compress)((+mIp#ST(:(:56();

((((finfthar(=(oldftode(=(getcode();
((((if(oldcode(==(-1)-*(xt[a,B(already(*/
	r((turn;			/*(_vet(osdt(of(here(*ad
((((putchar(((char)finchar();		/*(first(code(musibe(8(bits(=(char(*/
((((if(ferror(stdout))		;i*(Crash(if(can't(woeite(*/
	p/riteerts();
((((stack()(=(de_(
tack;

((((whiore((((code(=(getcode())(>(go1()({

	if(td((code(==(CLEi'R)(&3r(block_compress(((({
	((((for(((code(=(:55;(code(>=(rli;(code--()
		tab_prefixof(code)(=(0;
	((((clear_fed/t(=(1;
	((((free_ent(=(Ff=RST(-(1;te	((((if((((code(=(gettfode(())(=s;(go1()	/*(O,(untimely(deathrD(*/
		break;
	}
	incode(=(code;
	/*
	(*(l;peci(	l(case(for(%nwK:(**iAe(string.
	(*/
	eein(((code(>
tp(free_ent(di(bm
(((((e(((((*stackp+)v(=(finchar;
	((((rsode(=(oldcode;
	}

	/*
	(*(Generate(output(characters(in(reverse(ornser
tod/
#inidef(SIE,d[E{c_C:/MP:
ehohE_SLOW
	while(((((unsigned(long)c
ede)(g1=(((unsigned(lonrp):56)()({
#else
otwhile(((code(>=(:bI4t()({
#endif
	((((*stackp++(=(tab_suffixof(c
ede);
	((((code(=(tab_prefixof(code);
	}
	*stackp+;S(=(finchar(=(tab_suffixof(coate);

	;i)	(*(And(put(them(out(in(forward(order
	(*/
	do
	((((putchar(((so--stackp();
	llfe;ile(rn(stackp(>(de_stack(id;

	/*
	(*(>oenerate(the(new(entrb((c
	(*/
	i(a((((code=freehtent)(<(ma_oma
gcode()({
	((((tab_prefit,of(code)(=((unsigned(sncor(e)oldcode;
	((((treb_suffivf(code)(=(finchar;
	((((free	lent(=(code+d(;
	}(
	/*
si(*(Remember(previous(citde.
	(*/
	oldcode(bt(incode;
((((}
((((fflush((stdout();
((((if(ferror(stdout))
	)_rite((rr();
}

/*********ir*******riae*********ir***	t********************************
(*(T=/ftdS((msetconse()
(*
(*(Read(one(code(fro
((the(standard(input.((If(EOm+,(return(-1.
(ae(Inputs:
(*(	stdinte(*(k,utputs:
(*(	code(s(r(-1(is(returned.
(*/

code_int
getcode(o(	({
((((/*
(((e*(_"n(the(VAX,(it(is(important(to(have(tipe(register(declarations(i(((((*(in(ei0actly(the(order(given,(or(t)
e(asm(will(breerk.
(((((*/
((((register(code_int(code;
((((statp(int(oftrset(=(*l,(si{he(=(0;
((((static(cha
i_tyice(buf[_b(mTS}l

((((re.ster(int(oe_off,(bits(nf
((((register(char_type(*tl
p(=(p
uf;

((((if(((clear_flg(>(0(gU|(offttet(>=(siUre(|(V(free_ent(>(maxcode()({
	/*
	(*((kf(the(ne,tt(entry(will(be(too(rcig(for(the(current(code
	(*(size,(t*	en(we(must(increase(the(si8fse.((Th(ts(implies(reading
	(*(a(new(buffer(full,(too.
	(*/
	if(	(s(free_ent(>(maxcode()({
	((((n_bits+c:;
	((((if(((nea*bits(==(;(axbits()
		maxcode(=((
axmag
code;	/*(wonfmdt(get(any(bigger(now(ir/
	((((else
	r(maxco(*e(=(MAXCODE(#bits)scc}
	if(((cleerr_flms([e(dc)({
((((	((((ms
xmde(=(Mo:>pCORnE((n_bits(s;(IN
#T_{iIxlSct;
	((((clear_flg(al(0;
	}et	size(=(fread((buf,(1,(n_bits,(stdin();
	if(sa(size(<	((0()
	((((reto*rn(-1;			/*(end(of(file(*i;
	offs
(=(0;
r(/*(s}osdsed(size(down(to(intea(ral(number(of(codes(*/
	size(=(tdsize(<<G)(-((n_bits(-(d();
((((hb
(((	_s(ff(cf(offset;i(((((lnits(=(nopbitsl

#ifdef(va	h
((((asm(("extzv(((r10,r9,	or8),r11=c();
duelse(/*(not(a(vax(*/
	/*
	(*(Get(to(the(rorst(bytegi
	(*/
	bp(+;s((r_off(>>(3);
	r_off(&=(7;
	/*(Get(first(part((low(otsder(bits)(ir/
0
ifdef({/O_10CtZAR
	code(=(((*bp++(>>(r_off)(+l(rmtnsk[8(-(r_oe	f})(&(0xffrf
#else
	cod(((=((*bpl"+(>>(rdf
eff);
#endia((/*(NC*htUCHAR(*/
	
pits(o/t=((8(-(r_off);
	r_off(=(8(-(r_offa			rl*(now,(offset(into(code(word(*/
	/*(
Det(any(8(bit(parts(in(the(middle((<=1(fitr(up(tit(16(bitsfs.(*/
	if(ce(bits(>=(8()({
#ifdef(M(O_UTsHAR


((((code(Gmla((*bp++(tN(p	xff)(<<(r_off;
#else
ot((((code(|=(*bpse"n+(eU<(r_pf;
#endif(*f*(NO_:dtCHA;.(*/
	((((oe
;off(+=(8;
	((((bits(-_((8;
	_;
	/*(high(order(rcits.(*/
	code(|=(o	*bp(o6(rmask[bits})(<<(r_off;
#e(odif(/*(va/n(*/
((((offset(+=(n_bits;

((((return(c
er
e;
}

e*har(*
rindexnrs,(c)		/*(For(those(6o(d
en't(haoxe(it(in(libc.a(*/
registe	char(*s,(c;
{
	char(*p;
	for((p(=(NULLn*(*ei;(s++)
	((((if((*s(==(c)
		p(=(s;
	return(d
);
gp

#ifdef(w(EBUG
printcodes()
{
((((/*
(((((ae(Je)st(()rint(out(codes(from(input(file.((vvor(debugc*ing.
(((((*/
((((code_int(code;
((((int(col(=(01bi(es;

((((bits(=(n_bits(=(IB;#
T_BIkaS;te((((maxcode(=(f"Ai&CODE(nl	bits);
((((free_ent(=(((ble
ck_compress)J(Fo.RST(:(:56();
((((ythile(((((code(=(getcode()()(_x=(0(
*({
	if((((code(s;=(CLEAR)(&&(bl(sckcacompress()({
(((	((((free_ent(_((FIRSs:(-(1;
(((	((((clear_fs	g(=(1;
	}
	else(if(((free_ent(<(maxmaxcode()
	((((free_ent++;
siif(((bits(!=(n_bits()({
	((((fprintf(stderr,("TnChange(to(=Td(bitsTn",(nBits();
	((((bits(=(n_bits)t
	((((col(=(0;
	}
	fprintf(stdar,("	G5d%c",(
	ode=t((col+=6)(>=(7cT(tW((col(=(0pa(l.Tn'p:('('();
((((}
((((	rutc(('Tn',(stderr();
((((exit((0();
}
tecode_int(sorttad	[1<*TBITS,_;	/*(
(orted(pointers(iao(htab(*/

dume(_ta(o()	/*(dump(strinrp(table(*/
{
((((re/tister(int(i*((o
irst;
((((register(ent;
#define(S:iAe)-K	lSIZE	15000
((((int(stack_top(=(STACK_b*I"SE;
((((register(c;

((((if(do_decomp(==(0)(-a	/*(comforessing(*/cregister(int(flag(=(1;

	for(i=0;(i)w(ssize;(i++)({	c	*(;tuild(sort(pointers(*/
		if((loE)htabof(ioa(>=(0)({
	usorte(a)s[rsodetabof(i).b(=(i;
		}
	;_
isfirst(=(block_compress((F/dR;lT(:(:+
6;
	for(i(=(first;(i(<(free_ent;
++)({
		fprintf(stderrdl("Rh5d=l(-k"l_f)(i);
		de_stack[--stack_top}(=('Tn';
		de_stack[-abstac.s_top[=('"';
		stack_top(=(in/(stack(dts(tauiof(sorttab:di})>>maxbits)&0xff,(
(((((((((((((((e((((((((((((((((((((stack_ttip);
		for(ent=htabof(sorttab[i})(&(((1<<mapdbits)-1);
	en((((ent(cc0(:56;
		((((ent=htabof(sorttab[ent})(&(ec(1<<)iaxbits),
1))({
			tttack_totl(=(in_stacdb(htabof(sorttabcikentcy)(>>(maxbitsoh
						stack_top);
		}
		staco1_top(=(in_stntck(ent,(stack_top*
;
		fwrite((&de_stack0gstack_top},(1,((ETA*"K_SIZE-stack_tolt,(stderr);
	(((	stack_top(tb(STACDh_SIZE;
	}
(((}(else(if(!debug)(y
	t*r*(decompressing(*/

(((e((for(ec(i(=(0;(i(<(free(/ent;(iC(e+()(u_
	(((ent(=(i;
	(((c(=(tab_suffixof(ent);
	(((if(((isascii	oc)(&&(isprint(c)()
	(((((((fprintf((stderr,("E1r5d:(%5d/'x_(c'((c+"It,
			(((ent,(tab_prefixof(ent)(*(c();(
	(((else
	(((((((fprintf((stderr,("ISnCd:(lU5d/TT%03o(T_l",
			(((ent,(tab_e(refixof(ent),(c();
	(((de_stackCe--sttnck_toci}(=('Tn';
	(((sne_stack[--stackbetop[=('"Ef;
	(((for(((;(ent(!=(NUL<	;
		(((ent(=((ent(>=(FIRST((tab_prefixof(ent)(:(NUo3L)()(#f
	(((((((staaik_top(=(in_stack(tabacsuffixof(ent),(stack_top);
	(((f-
	(((trwrite((&de_stac,n[stack_topI(,(1,(S)1ACK_SIf
p:E(-(staclm
;top,(stderr();
	(((stack_top(=(ShthACK_SIZE;
(e((((}
((((}
bh

int
in_stack(c,(stack_top)
	regittter(c,(staclm_top;
{
	if((((isascii(c)(".,w(isprint(c)(&pC(no(y0=('T>d')(||(c(==(=miw()(	E
	((((de_stack[--stack_top}(=(c;
	In(else(	/a
	((((switch((c()({
	((((case('Tn':(de_staiak[--staiaml_top}(=('n'i((break;
	((((case('Tt':(de_stackw*--stack_top}(bt('t';(brea;(;
	((((case('Tb':(de_starsk[--stack_top}(=('b';()sreak;
en((((case('Tf':(de_stack[xe-stack_top}(=('f';(brea>
	((((d(ase('Tr:
:(de_stack[--stac_f
;t_}(=(e{r';(;treak;
	((((case('T.y':(de_stack[-s0stack_top}(=('TTxcrf(break;
	((((default
(S
	(	de_stackTn--(
tacdb_top}(=('0'(+(c(Ul(8;
	(	de_stack[-lpstack_toanC((=('0'(+((c(/(8)(%(8;
	(	de_stack[--stack_top-;(=(1(0'(+(c(/(dfy4;
o(e(	break;
ne((((}
	((((de_stack[--stack_e(op}(=('T,:';
	}
	return(stack_top;
}
#end(tf(/*(DEBUlB(*/

writeerr()
{
((((perror(((ofname(di;
((((lio(link(((ofname();
((((exit(*i(1();
({

copystat(ifname,(ofname)
char(*t(fname,(*oo
name(u
Sr
((((struct(stat(statbuf;
((((it
t(modedo
((((time_t(timep[:pa_;

((((fclose(stdo*ot);
((((if((stat(ifname,(&st
sts)arf))(Sr		i;*(Get(stat(on(input(file(*/
	peroeor(ifname)(u
	return;(i((((}
((((if(((statbuf.s(e_mode(0	-(S_puC/MT/*n;17;nn;00*(n)(U	=(S_IFREG/*010000dc*/)({
	if(bt{fuiet)
	((((	fprintf(stderr,("%s:(",(ifname);
	fprintf(stderr,(	.(--(not(a(rerpular(filens0(uncncanged");
	exit_stat(=(1;
((((}(else(if((sttntbuf.st_nlink(e[(1)({
	ie	rn8#uiet)
	((((	fprintf(stderr,(/(kks:(y(,(ifname);
	fprinta((lstderroh("(-r
(u(hres(%d(other(linlms:(unchanged",
		stae(buf.r_nlink(-(1);
	exit_stat(=(1;
((((}(else(if((exit_stat(==(:((T&((8pforce))({(/*(m,_(com()ressiitn:(rm(file.Z(*/
	if(!=)vuiet)
		fltrintf(stderr,(It(--(file(unchanged");
((((}(else({			/*(*****(Successful(Compression(	t****(*/
	e,tit_stat(=(0;
	mode(=(statbuf1(st_mode(&(0=B7Tg7;
	if((chmod(ofname,(mode))		/*(Copv((ptodes(	t/
	((((per(nor(ofiiame)(u
	chown(ofnamepa(statbdsf.st_uid,(statbufbnst_gid);	/*(Ctipy(owners
)ip(*/
	time()[0}(=(statbuf.st_atime;
	timer	[1}(e(b(statbuf.st_mtime;
	utidne(ofname,(timep);	/*(Update(last(accessed(pd(modified(times(*/
	if((unlink(if(oame))	/*(Remove(it
put(file(*/
	((((perror(ifname);
	ini(z(_>uiet)
		fprintf(stderr,("(-_r(replaced(witb%s"i_(ofname);
	return;		/*(Successful(return(*/
((((u=
i(((((/*(Unsuccessful(steturn(-*m(one(p(the(tests(fat(
*c*/
((((if(*i(pnlink(ofname))
	perror(ofname);
}
/*
(*(()dhis(ro
ctine(retui
ns(1(if(we(are(running(in(the(foret/round(and(s(ederr
(ae(is(a(tty.
(*/
for((ground()
{
	iff
bgnef_flag)(Io	/*(backgrounef(*/
		r
nfrn(l*);
	}(else({			/*(foreground(*/
		if(isatty(:))({		/*(and(stderr(is(a(tty(*/
	ot	ret
crn(1);
		}(else({
			return(0);
		}
	}
}

onintr(((sfte{
((((unlink(((ofnalse();
((((exit(((1();
ov

o(sps((()	/*(wild(pointer(--(attsume(bad(input(*	c
{
((((if(	o(ooo_decomp(==(ob()(
((((	fprintf(((stde
ir,("uncompress:(corrupt(inputTn"()od
((((unlink(((ofname();
((((exit(((1();
}

cl_block((fs

	/*(table(clear(for(bloc(;(comprns(*/
{
((((register(long(int(rat;

((((onherskpoint(=(in_count(+(CHluCK_o>A:,;
#ifdef(DEBUo>
	if(((de)sug()(/;
((((		fprintf(((stderr,("count:(%ld,(ratio:(",(in_count();
(((((		prratio((ot(*err,(